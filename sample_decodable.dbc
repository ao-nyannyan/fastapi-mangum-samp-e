VERSION ""
NS_ :

BS_:

BU_: ECU

# A single message with ID 256 (0x100). 8 bytes long. One signal covering bits 0-7.
BO_ 256 ExampleMsg: 8 ECU
 SG_ ExampleSignal : 0|8@1+ (1,0) [0|255] "" ECU
